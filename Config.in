## Config.in
```kconfig
config PINETAINERFS_PAQUETES_RENDIMIENTO
	bool "Paquetes de prueba de fiabilidad y rendimiento"
	select BR2_PACKAGE_STRESS
	select BR2_PACKAGE_DHRYSTONE
	select BR2_PACKAGE_RAMSPEED
	select BR2_PACKAGE_FIO
	help
	  Instala paquetes útiles para probar la fiabilidad de la
	  Pine H64 en la imagen final, así como su rendimiento.

config PINETAINERFS_PAQUETES_MEM_SECUNDARIA
	bool "Paquetes de memoria secundaria"
	select BR2_PACKAGE_MMC_UTILS
	help
	  Instala paquetes necesarios para obtener información
	  técnica de las MMC conectadas a la Pine.

config PINETAINERFS_PAQUETES_CRIPTOGRAFIA
	bool "Paquetes de criptografía"
	select BR2_PACKAGE_OPENSSL
	select BR2_PACKAGE_LIBOPENSSL_BIN
	help
	  Instala paquetes útiles para realizar operaciones
	  criptográficas en la Pine H64.

config PINETAINERFS_PAQUETES_CRIPTOGRAFIA_ACEL
	bool "Aceleración por cryptodev"
	depends on PINETAINERFS_PAQUETES_CRIPTOGRAFIA
	select BR2_PACKAGE_CRYPTODEV
	help
	  Permite probar el rendimiento de operaciones
	  criptográficas aceleradas por el Crypto Engine de la
	  Pine H64.
```

## configs/minipine_defconfig
```kconfig
BR2_aarch64=y
BR2_DL_DIR="$(CONFIG_DIR)/dl"
BR2_HOST_DIR="$(CONFIG_DIR)/host"
BR2_CCACHE=y
BR2_CCACHE_DIR="$(CONFIG_DIR)/.buildroot-ccache"
BR2_OPTIMIZE_FAST=y
BR2_GLOBAL_PATCH_DIR="$(BR2_EXTERNAL_PineTainer_PATH)/board/minipine/patches"
BR2_SSP_STRONG=y
BR2_RELRO_PARTIAL=y
BR2_TOOLCHAIN_BUILDROOT_VENDOR="pinetainer"
BR2_TOOLCHAIN_BUILDROOT_MUSL=y
BR2_KERNEL_HEADERS_5_2=y
BR2_BINUTILS_VERSION_2_32_X=y
BR2_TOOLCHAIN_BUILDROOT_CXX=y
BR2_GCC_ENABLE_LTO=y
BR2_GCC_ENABLE_OPENMP=y
BR2_TARGET_GENERIC_HOSTNAME=""
BR2_TARGET_GENERIC_ISSUE=""
BR2_ROOTFS_DEVICE_CREATION_DYNAMIC_MDEV=y
BR2_TARGET_GENERIC_ROOT_PASSWD="root"
# BR2_TARGET_GENERIC_GETTY is not set
# BR2_TARGET_GENERIC_REMOUNT_ROOTFS_RW is not set
BR2_ENABLE_LOCALE_WHITELIST="C"
BR2_ROOTFS_OVERLAY="$(BR2_EXTERNAL_PineTainer_PATH)/board/minipine/rootfs-overlay"
BR2_ROOTFS_POST_BUILD_SCRIPT="$(BR2_EXTERNAL_PineTainer_PATH)/board/minipine/post-build.sh"
BR2_ROOTFS_POST_IMAGE_SCRIPT="support/scripts/genimage.sh"
BR2_ROOTFS_POST_SCRIPT_ARGS="-c $(BR2_EXTERNAL_PineTainer_PATH)/board/minipine/genimage.cfg"
BR2_LINUX_KERNEL=y
BR2_LINUX_KERNEL_CUSTOM_VERSION=y
BR2_LINUX_KERNEL_CUSTOM_VERSION_VALUE="v5.3-rc4"
BR2_LINUX_KERNEL_USE_CUSTOM_CONFIG=y
BR2_LINUX_KERNEL_CUSTOM_CONFIG_FILE="$(BR2_EXTERNAL_PineTainer_PATH)/board/minipine/linux.config"
BR2_LINUX_KERNEL_LZ4=y
BR2_LINUX_KERNEL_DTS_SUPPORT=y
BR2_LINUX_KERNEL_INTREE_DTS_NAME="allwinner/sun50i-h6-pine-h64"
BR2_LINUX_KERNEL_NEEDS_HOST_OPENSSL=y
BR2_PACKAGE_LINUX_TOOLS_CPUPOWER=y
BR2_PACKAGE_LINUX_TOOLS_GPIO=y
BR2_PACKAGE_LINUX_TOOLS_PERF=y
BR2_PACKAGE_LINUX_TOOLS_TMON=y
BR2_PACKAGE_BUSYBOX_CONFIG="$(BR2_EXTERNAL_PineTainer_PATH)/board/minipine/busybox.config"
BR2_PACKAGE_BUSYBOX_SHOW_OTHERS=y
# BR2_PACKAGE_IFUPDOWN_SCRIPTS is not set
BR2_PACKAGE_WIRELESS_TOOLS=y
BR2_PACKAGE_WPA_SUPPLICANT=y
BR2_PACKAGE_WPA_SUPPLICANT_CLI=y
BR2_TARGET_ROOTFS_SQUASHFS=y
BR2_TARGET_ROOTFS_SQUASHFS4_LZ4=y
# BR2_TARGET_ROOTFS_TAR is not set
BR2_TARGET_ARM_TRUSTED_FIRMWARE=y
BR2_TARGET_ARM_TRUSTED_FIRMWARE_CUSTOM_VERSION=y
BR2_TARGET_ARM_TRUSTED_FIRMWARE_CUSTOM_VERSION_VALUE="v2.1"
BR2_TARGET_ARM_TRUSTED_FIRMWARE_PLATFORM="sun50i_h6"
BR2_TARGET_ARM_TRUSTED_FIRMWARE_ADDITIONAL_VARIABLES="CFLAGS=-fno-stack-protector"
BR2_TARGET_UBOOT=y
BR2_TARGET_UBOOT_BOARD_DEFCONFIG="pine_h64"
BR2_TARGET_UBOOT_NEEDS_DTC=y
BR2_TARGET_UBOOT_NEEDS_PYLIBFDT=y
BR2_TARGET_UBOOT_NEEDS_ATF_BL31=y
# BR2_TARGET_UBOOT_FORMAT_BIN is not set
BR2_TARGET_UBOOT_FORMAT_CUSTOM=y
BR2_TARGET_UBOOT_FORMAT_CUSTOM_NAME="u-boot.itb"
BR2_TARGET_UBOOT_SPL=y
BR2_TARGET_UBOOT_SPL_NAME="spl/sunxi-spl.bin"
BR2_TARGET_UBOOT_BOOT_SCRIPT=y
BR2_TARGET_UBOOT_BOOT_SCRIPT_SOURCE="$(BR2_EXTERNAL_PineTainer_PATH)/board/minipine/boot.cmd"
BR2_PACKAGE_HOST_DOSFSTOOLS=y
BR2_PACKAGE_HOST_GENIMAGE=y
BR2_PACKAGE_HOST_MTOOLS=y
```

## configs/pinechain_defconfig
```kconfig
BR2_DEFCONFIG="$(BR2_EXTERNAL_PINETAINER_PATH)/configs/pinechain_defconfig"
BR2_aarch64=y
BR2_OPTIMIZE_3=y
# BR2_COMPILER_PARANOID_UNSAFE_PATH is not set
BR2_REPRODUCIBLE=y
BR2_TOOLCHAIN_BUILDROOT_VENDOR="pinechain"
BR2_TOOLCHAIN_BUILDROOT_MUSL=y
BR2_BINUTILS_VERSION_2_34_X=y
BR2_GCC_VERSION_10_X=y
BR2_TOOLCHAIN_BUILDROOT_CXX=y
BR2_GCC_ENABLE_LTO=y
BR2_GCC_ENABLE_OPENMP=y
BR2_TARGET_GENERIC_HOSTNAME=""
BR2_TARGET_GENERIC_ISSUE=""
BR2_INIT_NONE=y
# BR2_TARGET_ENABLE_ROOT_LOGIN is not set
BR2_SYSTEM_BIN_SH_NONE=y
# BR2_TARGET_GENERIC_GETTY is not set
# BR2_TARGET_GENERIC_REMOUNT_ROOTFS_RW is not set
# BR2_PACKAGE_BUSYBOX is not set
# BR2_TARGET_ROOTFS_TAR is not set
```

## configs/pinetainer_defconfig
```kconfig
BR2_DEFCONFIG="$(BR2_EXTERNAL_PINETAINER_PATH)/configs/pinetainer_defconfig"
BR2_aarch64=y
BR2_CCACHE=y
BR2_OPTIMIZE_3=y
BR2_GLOBAL_PATCH_DIR="$(BR2_EXTERNAL_PINETAINER_PATH)/board/common/patches $(BR2_EXTERNAL_PINETAINER_PATH)/board/pinetainer/patches"
# BR2_COMPILER_PARANOID_UNSAFE_PATH is not set
BR2_REPRODUCIBLE=y
BR2_PIC_PIE=y
BR2_SSP_REGULAR=y
BR2_RELRO_PARTIAL=y
BR2_TOOLCHAIN_EXTERNAL=y
BR2_TOOLCHAIN_EXTERNAL_CUSTOM=y
BR2_TOOLCHAIN_EXTERNAL_PATH="$(BR2_EXTERNAL_PINETAINER_PATH)/aarch64-pinechain-linux-musl_sdk-buildroot"
BR2_TOOLCHAIN_EXTERNAL_CUSTOM_PREFIX="$(ARCH)-pinechain-linux-musl"
BR2_TOOLCHAIN_EXTERNAL_GCC_9=y
BR2_TOOLCHAIN_EXTERNAL_HEADERS_5_7=y
BR2_TOOLCHAIN_EXTERNAL_CUSTOM_MUSL=y
BR2_TOOLCHAIN_EXTERNAL_CXX=y
BR2_TOOLCHAIN_EXTERNAL_OPENMP=y
BR2_TARGET_OPTIMIZATION="-flto -fPIC"
BR2_TARGET_LDFLAGS="-fPIC"
BR2_TARGET_GENERIC_HOSTNAME=""
BR2_TARGET_GENERIC_ISSUE=""
BR2_INIT_SYSV=y
BR2_ROOTFS_DEVICE_CREATION_DYNAMIC_EUDEV=y
BR2_ROOTFS_DEVICE_TABLE="$(BR2_EXTERNAL_PINETAINER_PATH)/board/common/device_table.txt $(BR2_EXTERNAL_PINETAINER_PATH)/board/pinetainer/device_table.txt"
# BR2_TARGET_ENABLE_ROOT_LOGIN is not set
BR2_SYSTEM_BIN_SH_MKSH=y
# BR2_TARGET_GENERIC_GETTY is not set
# BR2_TARGET_GENERIC_REMOUNT_ROOTFS_RW is not set
BR2_ENABLE_LOCALE_WHITELIST="C"
BR2_ROOTFS_OVERLAY="$(BR2_EXTERNAL_PINETAINER_PATH)/board/common/rootfs-overlay $(BR2_EXTERNAL_PINETAINER_PATH)/board/pinetainer/rootfs-overlay"
BR2_ROOTFS_POST_BUILD_SCRIPT="$(BR2_EXTERNAL_PINETAINER_PATH)/board/common/post-build.sh $(BR2_EXTERNAL_PINETAINER_PATH)/board/pinetainer/post-build.sh"
BR2_ROOTFS_POST_FAKEROOT_SCRIPT="$(BR2_EXTERNAL_PINETAINER_PATH)/board/common/post-fakeroot.sh"
BR2_ROOTFS_POST_IMAGE_SCRIPT="$(BR2_EXTERNAL_PINETAINER_PATH)/board/common/post-image.sh"
BR2_ROOTFS_POST_SCRIPT_ARGS="-c $(BR2_EXTERNAL_PINETAINER_PATH)/board/pinetainer/genimage.cfg"
BR2_LINUX_KERNEL=y
BR2_LINUX_KERNEL_CUSTOM_VERSION=y
BR2_LINUX_KERNEL_CUSTOM_VERSION_VALUE="5.8"
BR2_LINUX_KERNEL_USE_CUSTOM_CONFIG=y
BR2_LINUX_KERNEL_CUSTOM_CONFIG_FILE="$(BR2_EXTERNAL_PINETAINER_PATH)/board/common/linux.config"
BR2_LINUX_KERNEL_CONFIG_FRAGMENT_FILES="$(BR2_EXTERNAL_PINETAINER_PATH)/board/pinetainer/linux.config"
BR2_LINUX_KERNEL_DTS_SUPPORT=y
BR2_LINUX_KERNEL_INTREE_DTS_NAME="allwinner/sun50i-h6-pine-h64-model-b"
BR2_LINUX_KERNEL_NEEDS_HOST_OPENSSL=y
BR2_PACKAGE_LINUX_TOOLS_CPUPOWER=y
BR2_PACKAGE_LINUX_TOOLS_GPIO=y
BR2_PACKAGE_LINUX_TOOLS_TMON=y
# BR2_PACKAGE_BUSYBOX is not set
BR2_PACKAGE_PIGZ=y
BR2_PACKAGE_XZ=y
BR2_PACKAGE_KEXEC=y
BR2_PACKAGE_LSOF=y
BR2_PACKAGE_FINDUTILS=y
BR2_PACKAGE_GAWK=y
BR2_PACKAGE_GREP=y
BR2_PACKAGE_PATCH=y
BR2_PACKAGE_SED=y
BR2_PACKAGE_F2FS_TOOLS=y
BR2_PACKAGE_SQUASHFS=y
BR2_PACKAGE_SQUASHFS_LZ4=y
BR2_PACKAGE_GNUPLOT=y
# BR2_PACKAGE_EUDEV_ENABLE_HWDB is not set
BR2_PACKAGE_LVM2=y
BR2_PACKAGE_CRYPTODEV=y
BR2_PACKAGE_DOVECOT=y
BR2_PACKAGE_EXIM=y
BR2_PACKAGE_QEMU=y
BR2_PACKAGE_QEMU_CUSTOM_TARGETS="aarch64-softmmu"
BR2_PACKAGE_QEMU_FDT=y
BR2_PACKAGE_QEMU_TOOLS=y
BR2_PACKAGE_CHRONY=y
BR2_PACKAGE_DNSMASQ=y
BR2_PACKAGE_DROPBEAR=y
# BR2_PACKAGE_DROPBEAR_CLIENT is not set
BR2_PACKAGE_DROPBEAR_DISABLE_REVERSEDNS=y
BR2_PACKAGE_ETHTOOL=y
BR2_PACKAGE_HOSTAPD=y
# BR2_PACKAGE_HOSTAPD_DRIVER_HOSTAP is not set
# BR2_PACKAGE_HOSTAPD_DRIVER_NL80211 is not set
BR2_PACKAGE_HOSTAPD_EAP=y
# BR2_PACKAGE_HOSTAPD_VLAN is not set
BR2_PACKAGE_IFTOP=y
BR2_PACKAGE_IFUPDOWN=y
BR2_PACKAGE_INADYN=y
BR2_PACKAGE_IPERF=y
BR2_PACKAGE_IPUTILS=y
BR2_PACKAGE_IW=y
BR2_PACKAGE_KNOCK=y
BR2_PACKAGE_NFTABLES=y
BR2_PACKAGE_NGINX=y
BR2_PACKAGE_NGINX_HTTP_SSL_MODULE=y
BR2_PACKAGE_NGINX_HTTP_XSLT_MODULE=y
BR2_PACKAGE_NGINX_HTTP_RANDOM_INDEX_MODULE=y
# BR2_PACKAGE_NGINX_HTTP_CHARSET_MODULE is not set
# BR2_PACKAGE_NGINX_HTTP_GZIP_MODULE is not set
# BR2_PACKAGE_NGINX_HTTP_USERID_MODULE is not set
# BR2_PACKAGE_NGINX_HTTP_ACCESS_MODULE is not set
# BR2_PACKAGE_NGINX_HTTP_GEO_MODULE is not set
# BR2_PACKAGE_NGINX_HTTP_SPLIT_CLIENTS_MODULE is not set
# BR2_PACKAGE_NGINX_HTTP_REFERER_MODULE is not set
# BR2_PACKAGE_NGINX_HTTP_FASTCGI_MODULE is not set
# BR2_PACKAGE_NGINX_HTTP_UWSGI_MODULE is not set
# BR2_PACKAGE_NGINX_HTTP_SCGI_MODULE is not set
# BR2_PACKAGE_NGINX_HTTP_MEMCACHED_MODULE is not set
# BR2_PACKAGE_NGINX_HTTP_EMPTY_GIF_MODULE is not set
# BR2_PACKAGE_NGINX_HTTP_BROWSER_MODULE is not set
# BR2_PACKAGE_NGINX_HTTP_UPSTREAM_IP_HASH_MODULE is not set
# BR2_PACKAGE_NGINX_HTTP_UPSTREAM_LEAST_CONN_MODULE is not set
# BR2_PACKAGE_NGINX_HTTP_UPSTREAM_KEEPALIVE_MODULE is not set
BR2_PACKAGE_NGINX_STREAM=y
BR2_PACKAGE_NGINX_STREAM_SSL_MODULE=y
# BR2_PACKAGE_NGINX_STREAM_ACCESS_MODULE is not set
# BR2_PACKAGE_NGINX_STREAM_GEO_MODULE is not set
# BR2_PACKAGE_NGINX_STREAM_MAP_MODULE is not set
# BR2_PACKAGE_NGINX_STREAM_SPLIT_CLIENTS_MODULE is not set
# BR2_PACKAGE_NGINX_STREAM_UPSTREAM_HASH_MODULE is not set
# BR2_PACKAGE_NGINX_STREAM_UPSTREAM_LEAST_CONN_MODULE is not set
# BR2_PACKAGE_NGINX_STREAM_UPSTREAM_ZONE_MODULE is not set
BR2_PACKAGE_RSYNC=y
BR2_PACKAGE_SOCAT=y
BR2_PACKAGE_STUNNEL=y
BR2_PACKAGE_TCPDUMP=y
BR2_PACKAGE_UACME=y
BR2_PACKAGE_WGET=y
BR2_PACKAGE_AT=y
BR2_PACKAGE_LOGROTATE=y
BR2_PACKAGE_TTYD=y
BR2_PACKAGE_WHICH=y
BR2_PACKAGE_COREUTILS=y
BR2_PACKAGE_DCRON=y
BR2_PACKAGE_HTOP=y
BR2_PACKAGE_KMOD_TOOLS=y
BR2_PACKAGE_PROCPS_NG=y
BR2_PACKAGE_PSMISC=y
BR2_PACKAGE_START_STOP_DAEMON=y
BR2_PACKAGE_TAR=y
BR2_PACKAGE_UTIL_LINUX_BINARIES=y
BR2_PACKAGE_UTIL_LINUX_FSCK=y
BR2_PACKAGE_UTIL_LINUX_HARDLINK=y
BR2_PACKAGE_UTIL_LINUX_HWCLOCK=y
BR2_PACKAGE_UTIL_LINUX_LOSETUP=y
BR2_PACKAGE_UTIL_LINUX_LSMEM=y
BR2_PACKAGE_UTIL_LINUX_MOUNT=y
BR2_PACKAGE_UTIL_LINUX_MOUNTPOINT=y
BR2_PACKAGE_UTIL_LINUX_NOLOGIN=y
BR2_PACKAGE_UTIL_LINUX_NSENTER=y
BR2_PACKAGE_UTIL_LINUX_PIVOT_ROOT=y
BR2_PACKAGE_UTIL_LINUX_SULOGIN=y
BR2_PACKAGE_UTIL_LINUX_UNSHARE=y
BR2_PACKAGE_UTIL_LINUX_ZRAMCTL=y
BR2_PACKAGE_WATCHDOG=y
BR2_PACKAGE_LESS=y
BR2_PACKAGE_NANO=y
BR2_TARGET_ROOTFS_SQUASHFS=y
BR2_TARGET_ROOTFS_SQUASHFS4_LZ4=y
# BR2_TARGET_ROOTFS_TAR is not set
BR2_TARGET_ARM_TRUSTED_FIRMWARE=y
BR2_TARGET_ARM_TRUSTED_FIRMWARE_CUSTOM_VERSION=y
BR2_TARGET_ARM_TRUSTED_FIRMWARE_CUSTOM_VERSION_VALUE="v2.3"
BR2_TARGET_ARM_TRUSTED_FIRMWARE_PLATFORM="sun50i_h6"
BR2_TARGET_ARM_TRUSTED_FIRMWARE_ADDITIONAL_VARIABLES="ENABLE_LTO=1"
BR2_TARGET_UBOOT=y
BR2_TARGET_UBOOT_USE_CUSTOM_CONFIG=y
BR2_TARGET_UBOOT_CUSTOM_CONFIG_FILE="$(BR2_EXTERNAL_PINETAINER_PATH)/board/common/uboot.config"
BR2_TARGET_UBOOT_CONFIG_FRAGMENT_FILES="$(BR2_EXTERNAL_PINETAINER_PATH)/board/pinetainer/uboot.config"
BR2_TARGET_UBOOT_NEEDS_DTC=y
BR2_TARGET_UBOOT_NEEDS_PYLIBFDT=y
BR2_TARGET_UBOOT_NEEDS_ATF_BL31=y
# BR2_TARGET_UBOOT_FORMAT_BIN is not set
BR2_TARGET_UBOOT_FORMAT_ITB=y
BR2_TARGET_UBOOT_SPL=y
BR2_TARGET_UBOOT_SPL_NAME="spl/sunxi-spl.bin"
BR2_TARGET_UBOOT_BOOT_SCRIPT=y
BR2_TARGET_UBOOT_BOOT_SCRIPT_SOURCE="$(BR2_EXTERNAL_PINETAINER_PATH)/board/pinetainer/boot.cmd"
BR2_PACKAGE_HOST_DOSFSTOOLS=y
BR2_PACKAGE_HOST_GENIMAGE=y
BR2_PACKAGE_HOST_MTOOLS=y
```
